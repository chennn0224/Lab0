## blinky/tests/BME280_UNIT_TEST/testcase.yaml
```yaml
# SPDX-License-Identifier: Apache-2.0

tests:
  bme280.temperature:
    platform_allow:
      - qemu_cortex_m3
    tags:
      - bme280
      - unit
    harness: ztest
  bme280.devicetree:
    platform_allow:
      - nrf7002dk/nrf5340/cpuapp/ns
    build_only: true
    extra_args:
      - DTC_OVERLAY_FILE=../../boards/nrf7002dk_nrf5340_cpuapp_ns.overlay
    tags:
      - bme280
      - devicetree
    harness: ztest
```
